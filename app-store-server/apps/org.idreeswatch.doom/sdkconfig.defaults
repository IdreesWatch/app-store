## app-store-server/apps/org.idreeswatch.doom/sdkconfig.defaults
```kconfig
CONFIG_IDF_TARGET="esp32s3"
CONFIG_ELF_LOADER=y
CONFIG_ELF_DYNAMIC_LOAD_SHARED_OBJECT=y
CONFIG_COMPILER_OPTIMIZATION_PERF=y
```
